## dts/bindings/rpc/zrpc,channel.yaml
```yaml
# Copyright (c) 2026 Vilhelm Engström
#
# SPDX-License-Identifier: Apache-2.0

description: |
  zRPC generic channel.

compatible: zrpc,channel

include: base.yaml

properties:
  zrpc,channel-id:
    type: int
    required: true
    description: |
      Numeric identifier of the channel to attach to the medium.

      Should match the ID of one of the channels in the zRPC configuration file. The RPCs
      defined for said channels are made available for the channel node.

  zrpc,host:
    type: boolean
    description: |
      Set to configure zRPC node in host mode. Must be set for exactly one of the peers
      in a pair.

  zrpc,heap-size:
    type: int
    default: 256
    description: |
      Size of the per-channel heap, in bytes. Used only if CONFIG_ZRPC_HEAP_TYPE_PER_CHANNEL is set.

examples:
  - |
    /* In devicetree */
    &sram4 {
      virtio_channel_0: memory@38000000 {
        compatible = "zrpc,virtio-channel";
                     "zrpc,channel";
        zrpc,channel-id = <0>; /* Attach the virito channel from the configuration */
      };
    };

    # In zRPC configuration
    channels:
      - name: virtio
        id: 0  # Attached to the virtio_channel_0 device
        rpcs:
          - name: heartbeat
            brief: Send heartbeat to peer.
            description: |
              Send a heartbeat RPC to the peer.
            origin: [ controller, target ]
        description:
          VirtIO-backed shared memory channel.
```

## dts/bindings/rpc/zrpc,virtio-channel.yaml
```yaml
# Copyright (c) 2026 Vilhelm Engström
#
# SPDX-License-Identifier: Apache-2.0

description: |
  zRPC hypervisorless virtio channel.

include:
  - name: base.yaml
  - name: zrpc,channel.yaml

compatible: zrpc,virtio-channel

properties:
  reg:
    required: true
    description: |
      Address and size of the shared memory area to use.

  zrpc,virtio-rx-stack-size:
    type: int
    default: 512
    description: |
      Size of the stack of the per-backend RX thread.

  zrpc,virtio-ipm-stack-size:
    type: int
    default: 512
    description: |
      Size of the stack of the per-backend IPM thread.

  zrpc,virtio-ipm-handle:
    type: phandle
    required: true
    description: |
      Handle referring to the inter-process mailbox to use.

  zrpc,virtio-ctrl-block-size:
    type: int
    default: 0x400
    description: |
      Default size of the shared memory control block.

      The backend reserves this number of bytes at the start of the shared memory section identified
      in the reg property for status flags.

      If unsure, leave unaltered.

  zrpc,virtio-virtqueue-num-extra-descs:
    type: int
    default: 16
    description:
      Number of struct vq_desc_extra instances to place after each virtqueue.

      If unsure, leave unaltered.

  zrpc,virtio-rx-queue-size:
    type: int
    default: 4
    description: |
      Number of entries that may be queued up in the RX queue.

      Queued up data is processed almost immediately. This value should rarely be large.

  zrpc,virtio-reply-queue-size:
    type: int
    default: 4
    description: |
      Number of RPC replies queued up in the driver. This property differs from
      zrpc,virtio-rx-queue-size in that the latter defines the size of a queue used
      internally by the driver to pass data from interrupt to process context whereas
      zrpc,virtio-reply-queue-size determines the size of the queue in which replies
      that have yet to be extracted by user code are buffered.

      Much like zrpc,virtio-rx-queue-size, this property rarely needs to be large.

  zrpc,virtio-max-concurrent-replies:
    type: int
    default: 4
    description: |
      Maximum concurrent number of replies in flight. Once the number is exceeded, newly issued RPCs
      fail until at least one of the outstanding RPCs has completed.

  zrpc,virtio-tx-chunk-size:
    type: int
    default: 512
    description: |
      Size of the memory chunks in which RPCs are transmitted. This setting effectively determines
      the maximum size of RPCs allowed over the channel. At the time of writing, said maximum
      is the value of this property - 16.
```

## subsys/rpc/Kconfig
```kconfig
# Copyright (c) 2026 Vilhelm Engström
#
# SPDX-License-Identifier: Apache-2.0

menu "Remote Procedure Calls"

rsource "Kconfig.zrpc"

endmenu
```
